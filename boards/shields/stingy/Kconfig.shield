## boards/shields/stingy/Kconfig.shield
```kconfig
# No whitespace after the comma or in your part name!
config SHIELD_STINGY_LEFT
    def_bool $(shields_list_contains,stingy_left)

# No whitespace after the comma or in your part name!
config SHIELD_STINGY_RIGHT
    def_bool $(shields_list_contains,stingy_right)
```
